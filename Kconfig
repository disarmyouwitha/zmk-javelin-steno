## Kconfig
```kconfig
menu "Javelin Steno Engine"

config ZMK_JAVELIN_STENO
    bool "Enable Javelin steno engine"
    default n
    select CPP
    select REQUIRES_FULL_LIBCPP

if ZMK_JAVELIN_STENO

config ZMK_JAVELIN_STENO_DICT_PLOVER
    bool "Include Plover dictionary (standard English)"
    default y

config ZMK_JAVELIN_STENO_DICT_LAPWING
    bool "Include Lapwing dictionary (modern, recommended for new learners)"
    default n

config ZMK_JAVELIN_STENO_EXTERNAL_LAPWING
    bool "Use the Zen R4's external QSPI Lapwing dictionary"
    depends on SOC_NRF52840
    select NRFX_QSPI
    select CRC

config ZMK_JAVELIN_STENO_SERIAL_PROVISIONING
    bool "Provision base dictionaries over the USB logging serial port"
    depends on ZMK_JAVELIN_STENO_EXTERNAL_LAPWING && ZMK_USB_LOGGING
    default y
    help
      Needed only to write or check the Lapwing and Plover base images with
      tools/zen-r4-lapwing/upload.py. Build with the zmk-usb-logging snippet
      to get it. Everyday builds can leave the snippet out: the bases already
      in flash still load, and the browser editor runs over HID.

config ZMK_JAVELIN_DIAG
    bool "Diagnostics on the logging serial port"
    depends on ZMK_JAVELIN_STENO_SERIAL_PROVISIONING
    select HWINFO
    default y
    help
      Adds a boot log that survives a soft reset, a status command, fault
      counters saved across reboots, and wake timing for the external flash.
      Serial commands: S status, D dump the boot log, Z clear log and counters.
      It compiles in only with the logging snippet. Turn it off, or delete
      src/zen_r4/diag.c and the diag_*() calls, once debugging is done.

config ZMK_JAVELIN_DIAG_RAIL_SENSE_PIN
    int "Port 0 pin that the R rail test reads"
    depends on ZMK_JAVELIN_DIAG
    range 0 31
    default 7
    help
      The R serial command switches the flash rail and reads this pin to see
      the rail rise and fall. Use the pin that the 10 k pull-up on the Steno
      Squid ties to the switched rail, which is chip select. The locked
      Boardsource map has it on P0.07. A handwired board may differ.

config ZMK_JAVELIN_STENO_QSPI_SCK_DIVIDER
    int "External flash clock divider (32 MHz / n)"
    depends on ZMK_JAVELIN_STENO_EXTERNAL_LAPWING
    range 1 16
    default 16
    help
      16 gives the 2 MHz clock proven on the handwired left half. A routed
      PCB should tolerate a much smaller divider, which shortens the full
      dictionary check after a cold boot. Confirm each new value with
      tools/zen-r4-qspi before relying on it.

config ZMK_JAVELIN_STENO_FLASH_IDLE_OFF
    bool "Power the external flash down while the dictionaries are idle"
    depends on ZMK_JAVELIN_STENO_EXTERNAL_LAPWING && ZMK_SLEEP
    default y
    help
      Switch the flash rail and QSPI off after a period with no dictionary
      use, except while the steno layer is selected. Selecting that layer
      powers it back up with the quick check, and so does an editor command,
      which waits while the flash starts. Set to n to keep the flash on
      whenever the keyboard is awake.

config ZMK_JAVELIN_STENO_FLASH_IDLE_SECONDS
    int "Seconds without dictionary use before the flash powers down"
    depends on ZMK_JAVELIN_STENO_FLASH_IDLE_OFF
    range 5 3600
    default 30

config ZMK_JAVELIN_STENO_BROWSER_DICTIONARY
    bool "Edit the personal dictionary over Javelin WebHID"
    depends on ZMK_JAVELIN_STENO_EXTERNAL_LAPWING

config ZMK_JAVELIN_STENO_BLE_HID
    bool "Expose the Javelin browser console over Bluetooth HID"
    depends on ZMK_JAVELIN_STENO_BROWSER_DICTIONARY && ZMK_BLE
    help
      Add an encrypted HID over GATT console using Javelin's existing WebHID
      report format. The browser tools require no website modifications.

config ZMK_JAVELIN_BATTERY_LOG
    bool "Record Zen R4 battery samples in a dedicated internal flash partition"
    depends on ZMK_JAVELIN_STENO_SERIAL_PROVISIONING && ZMK_BLE && FLASH_MAP && HWINFO
    select FCB

config ZMK_JAVELIN_STENO_MACOS_US_LAYOUT
    bool "Use macOS U.S./ABC accent and symbol keys in onboard Javelin"
    help
      Enable when the host uses the macOS U.S. or ABC input source.
      ASCII keys continue to use Javelin's US layout.

endif # ZMK_JAVELIN_STENO

endmenu

config ZMK_ZEN_R4_SPLIT_STATUS
    bool "Sync the Zen R4 layer to the right-half nice!view"
    depends on ZMK_SPLIT && ZMK_SPLIT_BLE
    depends on ZMK_SPLIT_ROLE_CENTRAL || (ZMK_DISPLAY && SHIELD_NICE_VIEW && ZMK_DISPLAY_STATUS_SCREEN_CUSTOM)

config ZMK_ZEN_R4_STROKE_TAPE
    bool "Show the last stroke, its translation and WPM on the right nice!view"
    depends on ZMK_ZEN_R4_SPLIT_STATUS
    default y
    help
      On the Javelin layer the left half sends each stroke's keys, its
      translation and the typing speed to the right display. This costs one
      small write on the split link per stroke, plus one for a translation
      longer than four characters.

config ZMK_ZEN_R4_STROKE_HINT
    bool "Also show a shorter outline when one exists"
    depends on ZMK_ZEN_R4_STROKE_TAPE && ZMK_JAVELIN_STENO && ZMK_SPLIT_ROLE_CENTRAL
    help
      The engine searches its dictionaries backwards for a shorter way to
      write what was just typed. That search runs on the thread that handles
      keys, so enable this only after the logging build shows it takes a few
      milliseconds at most.

config ZMK_ZEN_R4_PRACTICE
    bool "Offline single-stroke practice on the right nice!view"
    depends on ZMK_ZEN_R4_SPLIT_STATUS && ZMK_JAVELIN_STENO && ZMK_SPLIT_ROLE_CENTRAL

config ZMK_ZEN_R4_FONT_SAMPLER
    bool "Show a font sampler on the right nice!view"
    select LV_FONT_MONTSERRAT_20
    depends on ZMK_ZEN_R4_SPLIT_STATUS && !ZMK_SPLIT_ROLE_CENTRAL
```

## config/west.yml
```yaml
manifest:
  remotes:
    - name: zmkfirmware
      url-base: https://github.com/zmkfirmware
    - name: jthlim
      url-base: https://github.com/jthlim
    - name: disarmyouwitha
      url-base: https://github.com/disarmyouwitha
  projects:
    - name: zmk
      remote: zmkfirmware
      revision: 4dd95d7840eb3d5a3f59bb29fbf1ab054715ef85
      import: app/west.yml
    - name: javelin-steno
      remote: jthlim
      revision: 22726675b2dcf3b8b6ba1e20898f25e324b2260a
      path: javelin-steno
    # Fork of petercpark/zmk-hid-io-plover-hid at d895457, plus key names
    # for ZMK Studio (branch studio-key-names).
    - name: zmk-hid-io-plover-hid
      remote: disarmyouwitha
      revision: 73b112ccab30d2a9bf40609657daef35560575f1
  self:
    path: config
```

## dts/bindings/behaviors/zmk,behavior-javelin-practice.yaml
```yaml
description: |
  Steno practice key. On the steno layer it turns practice on or off. On any
  other layer it selects the steno layer with practice on.

compatible: "zmk,behavior-javelin-practice"

include: zero_param.yaml
```

## dts/bindings/behaviors/zmk,behavior-steno-squid-status.yaml
```yaml
description: Receive the active Steno Squid layer from the split central
compatible: "zmk,behavior-steno-squid-status"
include: two_param.yaml
```

## dts/bindings/behaviors/zmk,behavior-tap-first.yaml
```yaml
description: Tap-first parameter adapter for an existing hold-tap behavior
compatible: "zmk,behavior-tap-first"
include: two_param.yaml
properties:
  bindings:
    type: phandle
    required: true
```

## dts/bindings/behaviors/zmk,behavior-zen-r4-status.yaml
```yaml
description: Receive the active Zen R4 layer from the split central
compatible: "zmk,behavior-zen-r4-status"
include: two_param.yaml
```
