/* The Ultralight routes the display socket's chip select to D0. */
&nice_view_spi {
    cs-gpios = <&pro_micro 0 GPIO_ACTIVE_HIGH>;
};

/ {
    behaviors {
        zrst: zrst {
            compatible = "zmk,behavior-steno-squid-status";
            #binding-cells = <2>;
        };
    };
};
