// Give both steno modes direct entry from the right thumb cluster.
#define CORNE_RIGHT_MAIN_THUMBS &kp SPACE &to STENO &to PLOVER_HID
#include <behaviors/javelin_practice.dtsi>
// SYM+NUM with the outer right thumb starts practice on the steno layer. On
// that layer, the key left of the top S turns practice off and on.
#define CORNE_RIGHT_SYMBOL_THUMBS &none &kp N0 &javpractice
#define CORNE_STENO_SPARE_KEY &javpractice

#include "../corne.keymap"

&{/keymap} {
    // Spare layers that ZMK Studio can hand out. Builds without Studio ignore
    // them. Keep them last so the layers before them keep their IDs.
    extra1 {
        status = "reserved";
    };

    extra2 {
        status = "reserved";
    };
};
